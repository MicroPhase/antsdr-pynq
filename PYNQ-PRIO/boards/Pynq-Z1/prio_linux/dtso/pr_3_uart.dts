
/dts-v1/;
/plugin/;

/{
	compatible = "xlnx,zynq-7000";

	fragment@0 {
		target = <&amba>;

		__overlay__ {

			 pr_3_uart {
				compatible = "xlnx,xps-uartlite-1.00.a";
				interrupt-parent = <&intc>;
				interrupts = < 0x0 0x21 0x1 >;
				reg = < 0x41230000 0x10000 >;
				clock = <100000000>;
			};
		};
	};
};
