/dts-v1/;
/plugin/;

/{
	compatible = "xlnx,zynqmp";

	fragment@0 {		
		target = <&amba>;

		__overlay__ {

			gpio_base_leds {
				#gpio-cells = <2>;
				compatible = "xlnx,zynq-gpio-1.0";
				gpio-controller ;
				// interrupt-parent = <&gic>;
				//interrupts = < 0x0 0x5a 0x4 >;
				reg = <0x0 0x80046000 0x0 0x1000 >;
				xlnx,all-inputs = <0x0>;
				xlnx,all-inputs-2 = <0x0>;
				xlnx,dout-default = <0x0>;
				xlnx,dout-default-2 = <0x0>;
				xlnx,gpio-width = <0x4>;
				xlnx,gpio2-width = <0x20>;
				xlnx,interrupt-present = <0x1>;
				xlnx,is-dual = <0x0>;
				xlnx,tri-default = <0xffffffff>;
				xlnx,tri-default-2 = <0xffffffff>;
		    	};
			
		};
	};
};
